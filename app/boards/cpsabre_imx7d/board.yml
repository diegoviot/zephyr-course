## app/boards/cpsabre_imx7d/board.yml
```yaml
board:
  name: cpsabre_imx7d
  full_name: i.MX 7 Computer on Module - Sabre iMX7
  vendor: NXP
  socs:
    - name: mcimx7d
```

## app/boards/my_board_imx7d/board.yml
```yaml
board:
  name: my_board
  full_name: My board
  vendor: iomico
  socs:
    - name: mcimx7d
```

## app/boards/our_board/Kconfig.our_board
```kconfig
# Copyright 2017,2024 NXP
# SPDX-License-Identifier: Apache-2.0

config BOARD_OUR_BOARD
	select SOC_PART_NUMBER_MCIMX7D5EVM10SC
	select SOC_MCIMX7D_M4 if BOARD_OUR_BOARD
```

## app/boards/sabre_imx7d/board.yml
```yaml
board:
  name: sabre_imx7d
  full_name: NXP Sabre - i.MX 7 SoM - ARM M4 Core
  vendor: NXP
  socs:
    - name: mcimx7d
```
